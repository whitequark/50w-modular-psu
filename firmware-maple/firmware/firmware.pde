#include <string.h>
#include <stdio.h>
#include <stdarg.h>
#include <alloca.h>

#include <timer.h>
#include <spi.h>

#define IRQ(x) extern "C" void x()

const char font[][6] = {
  {0x00,0x00,0x00,0x00,0x00,0x00},   //   0x20 32
  {0x00,0x00,0x00,0x6f,0x00,0x00},   // ! 0x21 33
  {0x00,0x00,0x07,0x00,0x07,0x00},   // " 0x22 34
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  {0x00,0x04,0x02,0x04,0x08,0x04},   // ~ 0x7e 126
};

void lcd_write(int is_data, uint8 val) {
  gpio_write_bit(GPIOA, 5, 0); // sclk low
  gpio_write_bit(GPIOB, 7, 0); // cs low
  delay_us(1);
  gpio_write_bit(GPIOA, 7, is_data);
  gpio_write_bit(GPIOA, 5, 1); // sclk high
  delay_us(1);
   
  for(int i = 0; i < 8; i++) {
    gpio_write_bit(GPIOA, 5, false); // sclk low
    gpio_write_bit(GPIOA, 7, val & 0x80);
    delay_us(1);
    gpio_write_bit(GPIOA, 5, true); // sclk high
    delay_us(1);
    
    val <<= 1;
  }

  gpio_write_bit(GPIOB, 7, 1); // cs high
}

void lcd_init() {
  gpio_write_bit(GPIOA, 10, 0);
  delay_us(8);
  gpio_write_bit(GPIOA, 10, 1);
  delay_us(8);

  lcd_write(0, 0x11); // sleep out

  lcd_write(0, 0x36); // memory mode
  lcd_write(1, 0xc0); // invert X/Y

  lcd_write(0, 0x3A); // color mode
  lcd_write(1, 0x05); // 16bpp

  lcd_write(0, 0x29); // display on
}

void lcd_start() {
  lcd_write(0, 0x2c);
}

void lcd_finish() {
  lcd_write(0, 0x00);
}

void lcd_clip(int x1, int y1, int x2, int y2) {
  lcd_write(0, 0x2a); // set columns
  lcd_write(1, x1);
  lcd_write(1, x2);

  lcd_write(0, 0x2b); // set rows
  lcd_write(1, y1);
  lcd_write(1, y2);
}

void lcd_put(int color) {
  lcd_write(1, color >> 8);
  lcd_write(1, color & 0xff);
}

void lcd_clear(int color) {
  lcd_clip(2, 2, 130, 130);
  lcd_start();
  for(int i = 0; i < 128*128; i++) lcd_put(color);
  lcd_finish();
}

const int font_width = sizeof(font[0]);
void lcd_text(uint16 bg, uint16 fg, int x, int y, const char *str) {
  int len = strlen(str);
  lcd_clip(x, y, x + len * font_width - 1, y + 7);
  lcd_start();
  for(int j = 0; j < 8; j++) {
    for(int i = 0; i < len * font_width; i++) {
      char c = str[i / font_width];
      if(font[c - ' '][i % font_width] & (1 << j))
        lcd_put(fg);
      else
        lcd_put(bg);
    }
  }
  lcd_finish();
}

void lcd_printf(uint16 bg, uint16 fg, int x, int y, int w, const char *fmt, ...) {
  va_list vl;
  va_start(vl, fmt);
  char *display = (char*) alloca(w + 1);
  memset(display, 0, w + 1);
  vsnprintf(display, w + 1, fmt, vl);
  memset(display + strlen(display), 0x20, w - strlen(display));
  lcd_text(bg, fg, x, y, display);
  va_end(vl);
}

void update_freq();
void update_status();

void spi_reset() {
  spi_init(SPI2);
  SPI2_BASE->CR1 = SPI_CR1_MSTR | SPI_CR1_BR_PCLK_DIV_64 | SPI_CR1_CPHA | SPI_CR1_DFF_16_BIT;
  SPI2_BASE->CR2 = SPI_CR2_SSOE;
  spi_irq_enable(SPI2, SPI_RXNE_INTERRUPT);
}

void setup() {
  afio_init();
  gpio_init(GPIOA);
  gpio_init(GPIOB);
  gpio_init(GPIOC);
  timer_init(TIMER1);
  
  /* lcd */
  gpio_set_mode(GPIOB, 7, GPIO_OUTPUT_PP); // cs
  gpio_write_bit(GPIOB, 7, 1);
  gpio_set_mode(GPIOA, 10, GPIO_OUTPUT_PP); // reset
  gpio_set_mode(GPIOA, 7, GPIO_OUTPUT_PP); // mosi
  gpio_set_mode(GPIOA, 5, GPIO_OUTPUT_PP); // sck

  /* backlight */
  gpio_set_mode(GPIOA, 4, GPIO_OUTPUT_PP);
  gpio_write_bit(GPIOA, 4, 1);
  
  /* joystick */
  gpio_set_mode(GPIOC, 0, GPIO_INPUT_PU);
  gpio_write_bit(GPIOC, 0, 1);
  gpio_set_mode(GPIOC, 1, GPIO_INPUT_PU);
  gpio_write_bit(GPIOC, 1, 1);
  gpio_set_mode(GPIOC, 2, GPIO_INPUT_PU);
  gpio_write_bit(GPIOC, 2, 1);
  gpio_set_mode(GPIOC, 3, GPIO_INPUT_PU);
  gpio_write_bit(GPIOC, 3, 1);
  gpio_set_mode(GPIOC, 4, GPIO_INPUT_PU);
  gpio_write_bit(GPIOC, 4, 1);
  
  /* spi */
  AFIO_BASE->MAPR |= AFIO_MAPR_TIM1_REMAP_PARTIAL; // remap TIM1 away
  gpio_set_mode(GPIOB, 12, GPIO_OUTPUT_PP); // cs
  gpio_write_bit(GPIOB, 12, 1);
  gpio_set_mode(GPIOB, 13, GPIO_AF_OUTPUT_PP); // sck
  gpio_set_mode(GPIOB, 14, GPIO_INPUT_FLOATING); // miso
  gpio_set_mode(GPIOB, 15, GPIO_AF_OUTPUT_PP); // mosi
  spi_reset();

  /* PWM out */
  gpio_set_mode(GPIOA, 8, GPIO_AF_OUTPUT_PP);
  timer_adv_reg_map *regs = (TIMER1->regs).adv;
  regs->BDTR = TIMER_BDTR_MOE | TIMER_BDTR_LOCK_OFF;
  timer_set_prescaler(TIMER1, 0);
  timer_set_reload(TIMER1, 72000000/(80000*2));
  timer_oc_set_mode(TIMER1, TIMER_CH1, TIMER_OC_MODE_TOGGLE, TIMER_OC_PE);    
  timer_cc_enable(TIMER1, TIMER_CH1);
  timer_pause(TIMER1);
  
  /* subsystems */
  lcd_init();
  lcd_clear(0xffff);
  lcd_text(0xffff, 0x0000, 10, 10, "status:");
  update_status();
  lcd_text(0xffff, 0x0000, 10, 30, "frequency:");
  update_freq();
}

static inline int timer_status(timer_dev *dev) {
  return *bb_perip(&(dev->regs).bas->CR1, TIMER_CR1_CEN_BIT);
}

void update_status() {
  if(timer_status(TIMER1)) {
    lcd_text(0xffff, 0x03e0, 10, 19, "ON ");
  } else {
    lcd_text(0xffff, 0xf800, 10, 19, "OFF");
  }
}

void update_freq() {
  int freq = 72000000/((timer_get_reload(TIMER1)+1)*2);
  lcd_printf(0xffff, 0xf800, 10, 39, 14, "%d.%d kHz", freq/1000,freq%1000);
}

const int adc_ringbuf_size = 256;
uint16 adc_ringbuf[adc_ringbuf_size] = {0};
uint8 adc_ringbuf_pos = 0;
volatile uint16 adc_data = 0, adc_data_old = 0;
volatile int adc_dead = 1;
IRQ(__irq_spi2) {
  uint16 val = spi_rx_reg(SPI2);
  gpio_write_bit(GPIOB, 12, 1);
  spi_peripheral_disable(SPI2);

  if(val & 0xf000) {
    adc_dead = 1;
  } else {
    adc_dead = 0;
    adc_ringbuf[adc_ringbuf_pos++ % adc_ringbuf_size] = spi_rx_reg(SPI2);

    uint32 sum = 0;
    for(int i = 0; i < adc_ringbuf_size; i++) sum += adc_ringbuf[i];
    adc_data_old = adc_data;
    adc_data = sum / adc_ringbuf_size;
  }
}

static uint32 debounce = 0;

void loop() {
  if(debounce < systick_uptime_millis) {
    if(!gpio_read_bit(GPIOC, 1) || !gpio_read_bit(GPIOC, 4)) { // bottom, top
      int adjust = (!gpio_read_bit(GPIOC, 1)) ? -1 : 1;
      int reload = timer_get_reload(TIMER1);
      reload += adjust;
      timer_set_reload(TIMER1, reload);

      update_freq();
      debounce = systick_uptime_millis + 10;
    } else if(!gpio_read_bit(GPIOC, 3)) { // center
      if(!timer_status(TIMER1)) timer_resume(TIMER1);
      else timer_pause(TIMER1);
      update_status();
      debounce = systick_uptime_millis + 800;
    }
  }

  if(spi_is_tx_empty(SPI2)) {
    gpio_write_bit(GPIOB, 12, 0);
    spi_peripheral_enable(SPI2);
    spi_tx_reg(SPI2, 0x3300);
  }

  if(adc_dead) {
    lcd_text(0xffff, 0xf800, 10, 60, "DEAD");
    adc_data_old = 0;
  } else if(adc_data_old != adc_data) {
    lcd_printf(0xffff, 0x001f, 10, 60, 9, "%03x  %04x", adc_data, SPI2_BASE->SR);
    adc_data_old = adc_data;
  }

  if(SPI2_BASE->SR == 0x00) {
    spi_reset();
  }
}
